## components/tcpserver/Kconfig.projbuild
```kconfig
menu "WIFI Server Configuration"

    config WIFI_SSID
        string "WiFi SSID"
        default "myssid"
        help
            SSID (network name) for the example to connect to.

    config WIFI_PASSWORD
        string "WiFi Password"
        default "mypassword"
        help
            WiFi password (WPA or WPA2) for the example to use.
            Can be left blank if the network has no security set.

    config WIFI_IP
        string "IP ADDRESS"
        default "10.75.0.200"
        help
            IP ADDRESS.

    config WIFI_NM
        string "Netmask ADDRESS"
        default "255.255.255.0"
        help
            Netmask ADDRESS.

    config WIFI_GW
        string "Gateway ADDRESS"
        default "10.75.0.1"
        help
            Gateway ADDRESS.

    choice IP_MODE
        prompt "IP Version"
        help
            Example can use either IPV4 or IPV6.

        config IPV4
            bool "IPV4"

        config IPV6
            bool "IPV6"

    endchoice

    config LISTEN_PORT
        int "Port"
        range 0 65535
        default 3333
        help
            Local port the example server will listen on.

endmenu
```

## main/Kconfig.projbuild
```kconfig
menu "LoRa Configuration"

config devAdd
    string "Device Address"
    default "00000000"
    help
        4 Byte DEV EUI address(hex).

config netKey
    string "Net KEY"
    default "00000000000000000000000000000000"
    help
        16 Byte NETKEY address(hex).

config appKey
    string "APP Key"
    default "00000000000000000000000000000000"
    help
        16 Byte APP Key (hex).

config LORA_PIN_SPI_SCLK 
    int "SPI_SCLK PIN"
    default 5
    help
        LoRa CLK PIN.

config LORA_PIN_SPI_MOSI 
    int "SPI_MOSI PIN"
    default 27
    help
        LoRa MOSI PIN.

config LORA_PIN_SPI_MISO 
    int "SPI_MISO PIN"
    default 19
    help
        LoRa MISO PIN.

config LORA_PIN_NSS 
    int "NSS PIN"
    default 18
    help
        LoRa Radio NSS PIN.

config LORA_PIN_RST 
    int "RST PIN"
    default 14
    help
        LoRa Radio RST PIN.

config LORA_PIN_DIO0 
    int "DIO0 PIN"
    default 26
    help
        LoRa Radio DIO0 PIN.

config LORA_PIN_DIO1 
    int "DIO1 PIN"
    default 33
    help
        LoRa Radio DIO1 PIN.

config LORA_PIN_DIO2 
    int "DIO2 PIN"
    default 36
    help
        LoRa Radio DIO1 PIN.

config LORA_TX_INTERVAL 
    int "TX INTERVAL"
    default 180
    help
        LoRa TX INTERVAL.

endmenu

menu "BMX280 Configuration"

config SCA_PIN 
    int "SCA GPIO PIN"
    default 21
    help
        SCA GPIO PIN.

config SCL_PIN 
    int "SCL GPIO PIN"
    default 22
	    help
        SCL GPIO PIN.

endmenu
```
